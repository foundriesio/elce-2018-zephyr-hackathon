## CMakeLists.txt
```
cmake_minimum_required(VERSION 3.8.2)

# This application has its own Kconfig options.
set(KCONFIG_ROOT ${CMAKE_CURRENT_SOURCE_DIR}/Kconfig)

# CONF_FILE is prj.conf, plus (in addition to, not or)
# boards/${BOARD}.conf, if it exists. The board-specific file needs to
# be an absolute path; otherwise, the behavior of EXISTS is not
# well-defined.
set(CONF_FILE prj.conf)
if(EXISTS ${CMAKE_CURRENT_SOURCE_DIR}/boards/${BOARD}.conf)
  set(CONF_FILE ${CONF_FILE} " boards/${BOARD}.conf")
endif()

# Mandatory Zephyr boilerplate.
include($ENV{ZEPHYR_BASE}/cmake/app/boilerplate.cmake NO_POLICY_SCOPE)
project(NONE)

target_sources(app PRIVATE src/product_id.c)

# Application build configuration.
target_include_directories(app PRIVATE $ENV{ZEPHYR_BASE}/tests/include)
target_include_directories(app PRIVATE ${CMAKE_CURRENT_SOURCE_DIR}/src/lib)

target_sources(app PRIVATE src/main.c)
target_sources(app PRIVATE src/app_work_queue.c)
target_sources(app PRIVATE src/elce2018_mqtt.c)
target_sources_ifdef(CONFIG_BT               app PRIVATE src/bluetooth.c)
```

## Kconfig
```
# Copyright (c) 2017 Linaro Limited
# Copyright (c) 2017-2018 Foundries.io Ltd
#
# SPDX-License-Identifier: Apache-2.0
#

mainmenu "Foundries elce-2018-hackathon-cloud-app Configuration"

# Hidden option, enables device-specific settings
config ELCE2018_DEVICE
	bool
	default y
	select ELCE2018_DEVICE_SOC_SERIES_NRF52X if SOC_SERIES_NRF52X
	help
	  Main config to enable device specific settings

# "Nordic Semiconductor nRF52 device specific application settings.
# You could add another option for other SoC families.
config ELCE2018_DEVICE_SOC_SERIES_NRF52X
	bool
	select NET_IPV6
	select NET_CONFIG_NEED_IPV6
	select NET_CONFIG_BT_NODE
	select SENSOR
	select TEMP_NRF5
	select ENTROPY_NRF5_RNG
	select NET_SHELL if SOC_NRF52840
	default n

if ELCE2018_DEVICE_SOC_SERIES_NRF52X

config BT_DEVICE_NAME
	default "ELCE2018 IPSP node"

# This sets the temperature sensor device name so the application can find it.
config TEMP_NRF5_NAME
	default "die-temp"

config NET_CONFIG_PEER_IPV6_ADDR
	default "fe80::d4e7:0:0:1"

config NET_L2_BT
	default y

config NET_IF_UNICAST_IPV6_ADDR_COUNT
	default 3

config NET_IF_MCAST_IPV6_ADDR_COUNT
	default 2

config NET_CONFIG_INIT_TIMEOUT
	default 0

config NET_TCP_RETRY_COUNT
	# Reduced TCP retry count (default is 9) to avoid locking up the net and
	# bluetooth stack on packet retransmission as it consumes too much ram
	default 2 if SOC_NRF52832

config NET_UDP
	default n

config BT_RX_BUF_COUNT
	default 10

config BT_RX_BUF_LEN
	default 128

config BT_CTLR_RX_BUFFERS
	default 6

config BT_CTLR_TX_BUFFERS
	default 7

config BT_RX_STACK_SIZE
	default 2048

config BT_L2CAP_TX_BUF_COUNT
	default 6

# The following BT configs are not needed in peripheral mode.

config BT_CTLR_CONN_PARAM_REQ
	default n

config BT_CTLR_ADV_EXT
	default n

endif # ELCE2018_DEVICE_SOC_SERIES_NRF52X

# Settings which work for the gateway-side broker used for the hackathon. YMMV.

config ELCE2018_MQTT_USERNAME
	string "MQTT username"
	default "mqtt-username"
	help
	   Username value to use when connecting to MQTT broker.

config ELCE2018_MQTT_PASSWORD
	string "MQTT password"
	default ""
	help
	   Password value to use when connecting to MQTT broker.

	   If this is the empty string, a password based on the board
	   and a board-specific ID number will be used instead. This
	   is intended for testing and development only.

module = ELCE2018
module-dep = LOG
module-str = Log level for ELCE2018 application
source "subsys/logging/Kconfig.template.log_config"

# Leave this at the bottom: we need to override Zephyr's default settings
# with some of the values above.
source "$ZEPHYR_BASE/Kconfig.zephyr"
```

## prj.conf
```kconfig
CONFIG_BOOT_BANNER=y
CONFIG_REBOOT=y
CONFIG_FLASH=y
CONFIG_NETWORKING=y

# Network
CONFIG_NET_TCP=y
CONFIG_NET_MGMT=y
CONFIG_NET_MGMT_EVENT=y
CONFIG_NET_CONTEXT_NET_PKT_POOL=y
CONFIG_NET_RX_STACK_SIZE=2048
CONFIG_NET_PKT_RX_COUNT=10
CONFIG_NET_PKT_TX_COUNT=10
CONFIG_NET_BUF_RX_COUNT=15
CONFIG_NET_BUF_TX_COUNT=15
CONFIG_NET_BUF_DATA_SIZE=256
CONFIG_NET_TCP_INIT_RETRANSMISSION_TIMEOUT=2000

# MQTT
# Select MQTT_LIB manually for now to send temp data
CONFIG_MQTT_LIB=y
# This value was chosen arbitrarily
CONFIG_MQTT_MSG_MAX_SIZE=255
# add 2 more message allowance to the netbuf pool for MQTT
CONFIG_MQTT_ADDITIONAL_BUFFER_CTR=2
CONFIG_MQTT_SUBSCRIBE_MAX_TOPICS=2
# Add JSON support for formatting MQTT messages.
CONFIG_JSON_LIBRARY=y

# NET APP
CONFIG_NET_APP=y
CONFIG_NET_APP_CLIENT=y
CONFIG_NET_CONFIG_SETTINGS=y

# Logging
CONFIG_LOG=y
CONFIG_ELCE2018_LOG_LEVEL_DBG=y

# Bluetooth (when enabled) debug
#CONFIG_BT_DEBUG_LOG=y
#CONFIG_BT_DEBUG_HCI_DRIVER=y

# Debug helpers
#CONFIG_NET_LOG=y
#CONFIG_NET_APP_LOG_LEVEL_DBG=y
#CONFIG_NET_CORE_LOG_LEVEL_DBG=y
#CONFIG_NET_IF_LOG_LEVEL_DBG=y
#CONFIG_NET_UTILS_LOG_LEVEL_DBG=y
#CONFIG_NET_CONTEXT_LOG_LEVEL_DBG=y
#CONFIG_NET_PKT_LOG_LEVEL_DBG=y
#CONFIG_NET_CONN_LOG_LEVEL_DBG=y
#CONFIG_NET_ROUTE_LOG_LEVEL_DBG=y
#CONFIG_NET_IPV4_LOG_LEVEL_DBG=y
#CONFIG_NET_IPV6_LOG_LEVEL_DBG=y
#CONFIG_NET_ICMPV6_LOG_LEVEL_DBG=y
#CONFIG_NET_IPV6_NBR_CACHE_LOG_LEVEL_DBG=y
#CONFIG_NET_6LO_LOG_LEVEL_DBG=y
#CONFIG_NET_TCP_LOG_LEVEL_DBG=y
#CONFIG_NET_L2_ETHERNET_LOG_LEVEL_DBG=y
#CONFIG_NET_L2_BT_LOG_LEVEL_DBG=y
#CONFIG_INIT_STACKS=y
#CONFIG_STACK_USAGE=y
```

## src/main.c
```c
/*
 * Copyright (c) 2017 Linaro Limited
 * Copyright (c) 2018 Foundries.io
 *
 * SPDX-License-Identifier: Apache-2.0
 */

#define LOG_MODULE_NAME elce2018_main
#define LOG_LEVEL CONFIG_ELCE2018_LOG_LEVEL

#include <logging/log.h>
LOG_MODULE_REGISTER(LOG_MODULE_NAME);

#include "app_work_queue.h"
#include "product_id.h"
#include "elce2018_mqtt.h"

void main(void)
{
	app_wq_init();

	LOG_INF("ELCE 2018 Cloud Connected Hackathon application");
	LOG_INF("Board: %s, DeviceID: %x",
		product_id_get()->name, product_id_get()->number);

	LOG_INF("Running Built in Self Test (BIST)");

	LOG_INF("Initializing MQTT service\n");
	if (elce2018_mqtt_start()) {
		LOG_ERR("MQTT init failed; aborting!");
		return;
	}

	/*
	 * From this point on, just handle work.
	 */
	app_wq_run();
}
```

## src/app_work_queue.c
```c
/*
 * Copyright (c) 2016 Intel Corporation
 * Copyright (c) 2016 Wind River Systems, Inc.
 * Copyright (c) 2017 Linaro, Inc.
 *
 * SPDX-License-Identifier: Apache-2.0
 */

/*
 * This file copies the work queue implementation from Zephyr, but
 * allows users to just start running the work queue on a desired
 * thread.
 *
 * This is useful to avoid allocating two thread stacks if one thread
 * (in our case, the main thread) isn't using its stack for the
 * application's lifetime, and could be doing useful work instead.
 *
 * TODO: propose a more upstream-friendly way to support this.
 */

#include "app_work_queue.h"

static struct k_work_q app_queue;

struct k_work_q *app_work_q = &app_queue;

void app_wq_init(void)
{
	k_queue_init(&app_work_q->queue);
}

void app_wq_run(void)
{
	while (1) {
		struct k_work *work;
		k_work_handler_t handler;

		work = k_queue_get(&app_work_q->queue, K_FOREVER);
		if (!work) {
			k_yield();
			continue;
		}

		handler = work->handler;

		/* Reset pending state so it can be resubmitted by handler */
		if (atomic_test_and_clear_bit(work->flags,
					       K_WORK_STATE_PENDING)) {
			handler(work);
		}

		/* Make sure we don't hog up the CPU if the QUEUE never (or
		 * very rarely) gets empty.
		 */
		k_yield();
	}
}
```

## src/app_work_queue.h
```c
/*
 * Copyright (c) 2017 Linaro Limited
 * Copyright (c) 2018 Foundries.io
 *
 * SPDX-License-Identifier: Apache-2.0
 */

#ifndef ELCE2018_APP_WORK_QUEUE_H__
#define ELCE2018_APP_WORK_QUEUE_H__

/**
 * @file
 * @brief ELCE2018 application work queue
 *
 * This is a single work queue which can be used for sleeping tasks
 * within this application.
 *
 * Work handlers submitted to this queue may sleep or yield.
 *
 * Work may be submitted to this queue only by threads started from
 * main().
 */

#include <zephyr.h>
#include <zephyr/types.h>

/*
 * This is the work queue itself, which can be passed along to other
 * APIs which submit work.
 */
extern struct k_work_q *app_work_q;

/**
 * @brief Initialize the application work queue.
 *
 * Work may be submitted to the queue after this function returns. It
 * will not be processed until app_wq_run() is called.
 *
 * @see app_wq_run()
 */
void app_wq_init(void);

/**
 * @brief Start handling work queue events in the current thread.
 *
 * Unlike k_work_q_start(), this does not create a new thread;
 * instead, it runs in the caller's.
 *
 * @see k_work_q_start()
 */
FUNC_NORETURN
void app_wq_run(void);

/**
 * @brief Submit work to the application work queue thread.
 * @param work Work to submit
 * @see k_work_submit_to_queue()
 */
static inline void app_wq_submit(struct k_work *work)
{
	k_work_submit_to_queue(app_work_q, work);
}

/**
 * @brief Submit delayed work to the application work queue thread.
 * @param work     Work to submit
 * @param delay_ms Delay in milliseconds
 * @return k_delayed_work_submit_to_queue() return value.
 * @see k_delayed_work_submit_to_queue()
 */
static inline int app_wq_submit_delayed(struct k_delayed_work *work,
					s32_t delay_ms)
{
	return k_delayed_work_submit_to_queue(app_work_q, work, delay_ms);
}

#endif /* ELCE2018_APP_WORK_QUEUE_H__ */
```

## src/bluetooth.c
```c
/*
 * Copyright (c) 2016-2017 Linaro Limited
 * Copyright (c) 2018 Foundries.io Ltd
 *
 * SPDX-License-Identifier: Apache-2.0
 */

#define LOG_MODULE_NAME elce2018_bluetooth
#define LOG_LEVEL CONFIG_ELCE2018_LOG_LEVEL

#include <logging/log.h>
LOG_MODULE_REGISTER(LOG_MODULE_NAME);

#include <zephyr/types.h>
#include <stddef.h>
#include <errno.h>
#include <zephyr.h>

#include <bluetooth/bluetooth.h>
#include <bluetooth/hci.h>
#include <bluetooth/conn.h>
#include "bluetooth.h"

#include <init.h>
#include <logging/log_ctrl.h>
#include <misc/reboot.h>
#include <net/bt.h>
#include <net/net_if.h>
#include <net/net_mgmt.h>

#include "product_id.h"

static void set_own_bt_addr(bt_addr_le_t *addr)
{
	int i;
	u8_t tmp;

	/*
	 * Generate a static BT addr using the unique product number.
	 */
	for (i = 0; i < 4; i++) {
		tmp = (product_id_get()->number >> i * 8) & 0xff;
		addr->a.val[i] = tmp;
	}

	addr->a.val[4] = 0xe7;
/*
 * For CONFIG_NET_L2_BT_ZEP1656, the U/L bit of the BT MAC is toggled by Zephyr.
 * Later that MAC is used to create the 6LOWPAN IPv6 address.  To account for
 * that, we set 0xd6 here which toggles to 0xd4 later (matching the Linux
 * gateway configuration for bt0).
 */
#if defined(CONFIG_NET_L2_BT_ZEP1656)
	addr->a.val[5] = 0xd6;
#else
	addr->a.val[5] = 0xd4;
#endif
}

/* BT LE Connect/Disconnect callbacks */
static void set_bluetooth_led(bool state)
{
#if defined(BT_GPIO_PIN) && defined(BT_GPIO_CONTROLLER)
	struct device *gpio;

	gpio = device_get_binding(BT_GPIO_CONTROLLER);
	gpio_pin_configure(gpio, BT_GPIO_PIN, GPIO_DIR_OUT);
	gpio_pin_write(gpio, BT_GPIO_PIN, state);
#endif
}

static void connected(struct bt_conn *conn, u8_t err)
{
	if (err) {
		LOG_ERR("BT LE Connection failed: %u", err);
	} else {
		LOG_INF("BT LE Connected");
		set_bluetooth_led(1);
	}
}

static void disconnected(struct bt_conn *conn, u8_t reason)
{
	LOG_ERR("BT LE Disconnected (reason %u), rebooting!", reason);
	set_bluetooth_led(0);
	LOG_PANIC();
	sys_reboot(0);
}

static struct bt_conn_cb conn_callbacks = {
	.connected = connected,
	.disconnected = disconnected,
};

static int network_init(struct device *dev)
{
	bt_addr_le_t bt_addr;
	int ret = 0;

	/* Storage used to provide a BT MAC based on the serial number */
	LOG_INF("Setting Bluetooth MAC\n");

	memset(&bt_addr, 0, sizeof(bt_addr_le_t));
	bt_addr.type = BT_ADDR_LE_RANDOM;
	set_own_bt_addr(&bt_addr);
	ret = bt_set_id_addr(&bt_addr);
	bt_conn_cb_register(&conn_callbacks);

	return ret;
}

int bt_network_disable(void)
{
	/* TODO: use a better way to select BT interface */
	struct net_if *iface = net_if_get_default();
	int ret;

	ret = net_mgmt(NET_REQUEST_BT_DISCONNECT, iface, NULL, 0);
	if (ret < 0) {
		LOG_ERR("Disconnect failed:%d", ret);
		return ret;
	}

	ret = net_mgmt(NET_REQUEST_BT_ADVERTISE, iface, "off", 0);
	if (ret < 0) {
		LOG_ERR("Error stopping advertise:%d", ret);
		return ret;
	}

	return 0;
}

/* last priority in the POST_KERNEL init levels */
SYS_INIT(network_init, APPLICATION, CONFIG_APPLICATION_INIT_PRIORITY);
```

## src/bluetooth.h
```c
/*
 * Copyright (c) 2016 Linaro Limited
 * Copyright (c) 2018 Foundries.io Ltd
 *
 * SPDX-License-Identifier: Apache-2.0
 */

#ifndef ELCE2018_BLUETOOTH_H__
#define ELCE2018_BLUETOOTH_H__

int bt_network_disable(void);

#endif /* ELCE2018_BLUETOOTH_H__ */
```

## src/elce2018_mqtt.c
```c
/*
 * Copyright (c) 2017 Linaro Limited
 * Copyright (c) 2017-2018 Foundries.io Ltd
 *
 * SPDX-License-Identifier: Apache-2.0
 */

/*
 * Much of the initial code here was pulled from
 * samples/net/mqtt_publisher
 */

#define LOG_MODULE_NAME elce2018_mqtt_temp
#define LOG_LEVEL CONFIG_ELCE2018_LOG_LEVEL

#include <logging/log.h>
LOG_MODULE_REGISTER(LOG_MODULE_NAME);

#include <errno.h>
#include <stdio.h>
#include <string.h>
#include <stdarg.h>

#include <device.h>
#include <json.h>
#include <logging/log_ctrl.h>
#include <misc/reboot.h>
#include <net/net_app.h>
#include <net/net_event.h>
#include <net/net_if.h>
#include <net/net_mgmt.h>
#include <net/mqtt.h>
#include <sensor.h>
#include <toolchain.h>
#include <zephyr.h>

#include "product_id.h"
#include "app_work_queue.h"
#include "elce2018_mqtt.h"
#ifdef CONFIG_NET_L2_BT
#include "bluetooth.h"
#endif

#define MAX_FAILURES		5
#define NUM_TEST_RESULTS	5
#define AMB_TEMP_DEV		"ambient-temp"
#define DIE_TEMP_DEV		"die-temp"
#define MQTT_PORT		1883
#define MQTT_USERNAME		CONFIG_ELCE2018_MQTT_USERNAME
#define MQTT_PASSWORD		CONFIG_ELCE2018_MQTT_PASSWORD
#define MQTT_CONNECT_TRIES	10
#define APP_CONNECT_TRIES	10
#define CONNECT_WAIT_TIMEOUT	K_MSEC(500)
#define PUBLISH_DELAY_TIME	K_SECONDS(3)
#define MQTT_NET_TIMEOUT	K_MSEC(300)

/* Network configuration checks */
#if defined(CONFIG_NET_IPV6)
BUILD_ASSERT_MSG(sizeof(CONFIG_NET_CONFIG_PEER_IPV6_ADDR) > 1,
		"CONFIG_NET_CONFIG_PEER_IPV6_ADDR must be defined in boards/$(BOARD)-local.conf");
#define MQTT_HELPER_SERVER_ADDR    CONFIG_NET_CONFIG_PEER_IPV6_ADDR
#elif defined(CONFIG_NET_IPV4)
#if !defined(CONFIG_NET_DHCPV4)
BUILD_ASSERT_MSG(sizeof(CONFIG_NET_CONFIG_MY_IPV4_ADDR) > 1,
		"DHCPv4 must be enabled, or CONFIG_NET_CONFIG_MY_IPV4_ADDR must be defined, in boards/$(BOARD)-local.conf");
#endif
BUILD_ASSERT_MSG(sizeof(CONFIG_NET_CONFIG_PEER_IPV4_ADDR) > 1,
		"CONFIG_NET_CONFIG_PEER_IPV4_ADDR must be defined in boards/$(BOARD)-local.conf");
#define MQTT_HELPER_SERVER_ADDR    CONFIG_NET_CONFIG_PEER_IPV4_ADDR
#endif

/*
 * All possible sources of data. Add your own extensions for the hackathon!
 *
 * This (or a subset of it) is what gets serialized into JSON.
 */
struct mqtt_sensor_data {
	int amb_temp;
	int die_temp;
};

#define MAX_SENSOR_DATA 2

/*
 * Main context object.
 */
struct elce2018_mqtt_data {
	/* MQTT plumbing. */
	u8_t mqtt_client_id[30];	/* Device-unique identifier */
	u8_t mqtt_password[20];	/* MQTT password */
	u8_t mqtt_topic[255];		/* Buffer for topic names */
	u8_t mqtt_message[1024];	/* Buffer for message data */
	struct mqtt_ctx mqtt;
	struct mqtt_connect_msg connect_msg;
	struct mqtt_publish_msg pub_msg;
	struct k_sem mqtt_wait_sem;
	struct k_delayed_work mqtt_work;
	int failures;

	/* Sensor data sources. Extend for the hackathon! */
	struct device *amb_dev;
	struct device *die_dev;
	struct mqtt_sensor_data sensor_data;
	/*
	 * This gets built up at runtime depending on the devices that
	 * were discovered.
	 */
	struct json_obj_descr sensor_json_descr[MAX_SENSOR_DATA];
	int sensor_num_sources;
};

/*
 * JSON descriptor objects. Extend for the hackathon!
 */
static const struct json_obj_descr json_amb_temp_descr =
	JSON_OBJ_DESCR_PRIM(struct mqtt_sensor_data, amb_temp, JSON_TOK_NUMBER);

static const struct json_obj_descr json_die_temp_descr =
	JSON_OBJ_DESCR_PRIM(struct mqtt_sensor_data, die_temp,
			    JSON_TOK_NUMBER);

static struct elce2018_mqtt_data temp_data;

#if defined(CONFIG_NET_MGMT_EVENT)
static struct net_mgmt_event_callback net_mgmt_cb;
#endif

#if defined(CONFIG_NET_CONTEXT_NET_PKT_POOL)
NET_PKT_TX_SLAB_DEFINE(mqtt_client_tx, 5);
NET_PKT_DATA_POOL_DEFINE(mqtt_client_data, 15);

static struct k_mem_slab *tx_slab(void)
{
	return &mqtt_client_tx;
}

static struct net_buf_pool *data_pool(void)
{
	return &mqtt_client_data;
}
#else
#if defined(CONFIG_NET_L2_BT)
#error "TCP connections over Bluetooth need CONFIG_NET_CONTEXT_NET_PKT_POOL "\
	"defined."
#endif /* CONFIG_NET_L2_BT */

#define tx_slab NULL
#define data_pool NULL
#endif /* CONFIG_NET_CONTEXT_NET_PKT_POOL */

static void elce2018_mqtt_reboot_check(struct elce2018_mqtt_data *data, int result)
{
	if (result) {
		if (++data->failures >= MAX_FAILURES) {
			LOG_ERR("Too many MQTT errors, rebooting!");
#ifdef CONFIG_NET_L2_BT
			bt_network_disable();
#endif
			LOG_PANIC();
			sys_reboot(0);
		}
	} else {
		data->failures = 0;
	}
}

/*
 * Sensor data handling
 */

static int read_temperature(struct device *temp_dev,
			    enum sensor_channel temp_channel,
			    struct sensor_value *temp_val)
{
	__unused const char *name = temp_dev->config->name;
	int ret;

	ret = sensor_sample_fetch(temp_dev);
	if (ret) {
		LOG_ERR("%s: I/O error: %d", name, ret);
		return ret;
	}

	ret = sensor_channel_get(temp_dev, temp_channel, temp_val);
	if (ret) {
		LOG_ERR("%s: can't get data: %d", name, ret);
		return ret;
	}

	LOG_DBG("%s: read %d.%d C", name, temp_val->val1, temp_val->val2);
	return 0;
}


/*
 * MQTT callbacks and other plumbing.
 */

static inline struct elce2018_mqtt_data *mqtt_to_data(struct mqtt_ctx *mqtt)
{
	return CONTAINER_OF(mqtt, struct elce2018_mqtt_data, mqtt);
}

static inline int elce2018_mqtt_wait(struct elce2018_mqtt_data *data, s32_t timeout)
{
	return k_sem_take(&data->mqtt_wait_sem, timeout);
}

static void elce2018_mqtt_connect_cb(struct mqtt_ctx *mqtt)
{
	LOG_DBG("connected");
	k_sem_give(&mqtt_to_data(mqtt)->mqtt_wait_sem);
}

static void elce2018_mqtt_disconnect_cb(struct mqtt_ctx *mqtt)
{
	LOG_DBG("disconnected");
	k_sem_give(&mqtt_to_data(mqtt)->mqtt_wait_sem);
}

static void elce2018_mqtt_malformed_cb(struct mqtt_ctx *mqtt, u16_t pkt_type)
{
	LOG_DBG("malformed data, type 0x%x", pkt_type);
}

/*
 * Try to connect to the MQTT broker. The helper context must have
 * properly initialized mqtt and connect_msg fields.
 */
static int elce2018_mqtt_connect(struct elce2018_mqtt_data *data)
{
	struct mqtt_ctx *mqtt = &data->mqtt;
	struct mqtt_connect_msg *msg = &data->connect_msg;
	int i = 0;
	int ret = 0;

	for (i = 0; i < MQTT_CONNECT_TRIES; i++) {
		ret = mqtt_connect(mqtt);
		if (!ret) {
			break;
		}
	}

	if (ret) {
		return ret;
	}

	for (i = 0; i < APP_CONNECT_TRIES; i++) {
		ret = mqtt_tx_connect(mqtt, msg);
		if (ret) {
			LOG_ERR("mqtt_tx_connect: %d", ret);
			continue;
		}
		ret = elce2018_mqtt_wait(data, CONNECT_WAIT_TIMEOUT);

		if (mqtt->connected) {
			return 0;
		}
	}

	mqtt_close(&data->mqtt);
	LOG_ERR("timed out");
	return -ETIMEDOUT;
}

static int elce2018_mqtt_publish(struct elce2018_mqtt_data *data)
{
	struct mqtt_publish_msg *pub_msg = &data->pub_msg;
	int ret;

	/*
	 * Set up the topic and message contents. Extend for the hackathon!
	 */
	snprintk(data->mqtt_topic, sizeof(data->mqtt_topic),
		 "id/%s/sensor-data/json", data->mqtt_client_id);
	ret =  json_obj_encode_buf(data->sensor_json_descr,
				   data->sensor_num_sources,
				   &data->sensor_data,
				   data->mqtt_message,
				   sizeof(data->mqtt_message) - 1);
	if (ret) {
		LOG_ERR("json_obj_encode_buf: %d", ret);
		return ret;
	}

	/* Fill out the MQTT publication, and ship it.
	 *
	 * IMPORTANT: don't increase the level of QoS here, even if
	 *            Zephyr claims to support it, until the Zephyr
	 *            MQTT stack can correctly parse multiple MQTT
	 *            packets within a single struct net_pkt.
	 *
	 * Working around that issue implies never receiving multiple
	 * MQTT packets in the same net_pkt.
	 *
	 * Keep this at QoS 0 to avoid receiving PUBACK or PUBREC in
	 * response to this message. Since this app is a publisher
	 * only, the remaining possible incoming messages are CONNACK
	 * and PINGRESP (depending on nonzero keep_alive). Those will
	 * never be transmitted at the same time, as we ought to wait
	 * for CONNACK before sending any PINGREQs.
	 */
	pub_msg->msg = data->mqtt_message;
	pub_msg->msg_len = strlen(pub_msg->msg);
	pub_msg->qos = MQTT_QoS0;
	pub_msg->topic = data->mqtt_topic;
	pub_msg->topic_len = strlen(pub_msg->topic);

	LOG_DBG("topic: %s", data->pub_msg.topic);
	LOG_DBG("message: %s", data->pub_msg.msg);
	ret = mqtt_tx_publish(&data->mqtt, &data->pub_msg);
	if (ret) {
		LOG_ERR("publish failed: %d", ret);
	}

	return ret;
}

static void elce2018_mqtt_try_to_publish(struct k_work *work)
{
	struct elce2018_mqtt_data *data =
		CONTAINER_OF(work, struct elce2018_mqtt_data, mqtt_work);
	struct sensor_value mcu_val;
	struct sensor_value die_val;
	int ret = 0;

	if (!data->mqtt.connected) {
		ret = elce2018_mqtt_connect(data);
		if (ret) {
			LOG_ERR("connection failed: %d", ret);
			goto out;
		}
	}

	/*
	 * Try to read temperature sensor values, and publish the
	 * whole number portion of temperatures that are read.
	 *
	 * Extend for the hackathon!
	 */
	if (data->amb_dev) {
		ret = read_temperature(data->amb_dev,
				       SENSOR_CHAN_AMBIENT_TEMP,
				       &mcu_val);
	}
	if (ret) {
		goto out;
	}
	if (data->die_dev) {
		ret = read_temperature(data->die_dev,
				       SENSOR_CHAN_DIE_TEMP,
				       &die_val);
	}
	if (ret) {
		goto out;
	}

	if (data->amb_dev) {
		data->sensor_data.amb_temp = mcu_val.val1;
	}
	if (data->die_dev) {
		data->sensor_data.die_temp = die_val.val1;
	}

	ret = elce2018_mqtt_publish(data);

 out:
	elce2018_mqtt_reboot_check(data, ret);
	app_wq_submit_delayed(&data->mqtt_work, PUBLISH_DELAY_TIME);
}

/*
 * Initialization
 */

static int init_mqtt_plumbing(struct elce2018_mqtt_data *data)
{
	int ret;

	snprintk(data->mqtt_client_id, sizeof(data->mqtt_client_id), "%s-%08x",
		 CONFIG_BOARD, product_id_get()->number);
	if (!strcmp(MQTT_PASSWORD, "")) {
		snprintk(data->mqtt_password, sizeof(data->mqtt_password),
			 "%08x", product_id_get()->number);
	} else {
		snprintk(data->mqtt_password, sizeof(data->mqtt_password),
			 "%s", MQTT_PASSWORD);
	}

	data->mqtt.connect = elce2018_mqtt_connect_cb;
	data->mqtt.disconnect = elce2018_mqtt_disconnect_cb;
	data->mqtt.malformed = elce2018_mqtt_malformed_cb;
	data->mqtt.net_timeout = MQTT_NET_TIMEOUT;
	data->mqtt.peer_addr_str = MQTT_HELPER_SERVER_ADDR;
	data->mqtt.peer_port = MQTT_PORT;
	ret = mqtt_init(&data->mqtt, MQTT_APP_PUBLISHER);
	if (ret) {
		return ret;
	}

#if defined(CONFIG_NET_CONTEXT_NET_PKT_POOL)
	net_app_set_net_pkt_pool(&data->mqtt.net_app_ctx, tx_slab, data_pool);
#endif

	data->connect_msg.client_id = data->mqtt_client_id;
	data->connect_msg.client_id_len = strlen(data->connect_msg.client_id);
	data->connect_msg.keep_alive = 0;
	data->connect_msg.user_name = MQTT_USERNAME;
	data->connect_msg.user_name_len = strlen(data->connect_msg.user_name);
	data->connect_msg.password = data->mqtt_client_id;
	data->connect_msg.password_len = strlen(data->connect_msg.password);
	data->connect_msg.clean_session = 1;

	k_sem_init(&data->mqtt_wait_sem, 0, 1);
	k_delayed_work_init(&data->mqtt_work, elce2018_mqtt_try_to_publish);

	data->failures = 0;

	return 0;
}

/*
 * Initialize sources of sensor data. Extend for the hackathon!
 */
static int init_sensor_sources(struct elce2018_mqtt_data *data)
{
	int num_sources = 0;
	data->amb_dev = device_get_binding(AMB_TEMP_DEV);
	data->die_dev = device_get_binding(DIE_TEMP_DEV);

	LOG_INF("%s ambient temperature sensor %s",
		data->amb_dev ? "Found" : "Did not find", AMB_TEMP_DEV);
	if (data->amb_dev) {
		memcpy(&data->sensor_json_descr[num_sources],
		       &json_amb_temp_descr,
		       sizeof(struct json_obj_descr));
		num_sources++;
	}

	LOG_INF("%s die temperature sensor %s",
		data->die_dev ? "Found" : "Did not find", DIE_TEMP_DEV);
	if (data->die_dev) {
		memcpy(&data->sensor_json_descr[num_sources],
		       &json_die_temp_descr,
		       sizeof(struct json_obj_descr));
		num_sources++;
	}

	if (num_sources == 0) {
		LOG_ERR("No temperature devices found.");
		return -ENODEV;
	}

	data->sensor_num_sources = num_sources;
	return 0;
}

static int elce2018_mqtt_init_data(struct elce2018_mqtt_data *data)
{
	int ret;

	ret = init_mqtt_plumbing(data);
	if (ret) {
		return ret;
	}

	ret = init_sensor_sources(data);
	if (ret) {
		return ret;
	}

	return 0;
}

static void elce2018_mqtt_net_cb(struct net_mgmt_event_callback *cb,
				 u32_t mgmt_event, struct net_if *iface)
{
	struct elce2018_mqtt_data *data = &temp_data;

	app_wq_submit_delayed(&data->mqtt_work, PUBLISH_DELAY_TIME);
}

int elce2018_mqtt_start(void)
{
	/* TODO: default interface may not be the one used by MQTT. */
	struct net_if *iface = net_if_get_default();
	int ret;

	ret = elce2018_mqtt_init_data(&temp_data);
	if (ret) {
		LOG_ERR("can't initialize: %d", ret);
		return ret;
	}

	/*
	 * Try to start publishing sensor data if the network
	 * interface is up. If it's not up, wait until it is to start
	 * publishing.
	 */
#if defined(CONFIG_NET_MGMT_EVENT)
	/* Subscribe to NET_EVENT_IF_UP if interface is not ready */
	if (!net_if_is_up(iface)) {
		net_mgmt_init_event_callback(&net_mgmt_cb,
					     elce2018_mqtt_net_cb,
					     NET_EVENT_IF_UP);
		net_mgmt_add_event_callback(&net_mgmt_cb);
		return 0;
	}
#endif

	elce2018_mqtt_net_cb(NULL, NET_EVENT_IF_UP, iface);
	return 0;
}
```

## src/elce2018_mqtt.h
```c
/*
 * Copyright (c) 2018 Foundries.io
 *
 * SPDX-License-Identifier: Apache-2.0
 */

/**
 * @file
 * @brief ELCE 2018 Cloud Connected Hackathon MQTT public header
 */

#ifndef ELCE2018_MQTT_H__
#define ELCE2018_MQTT_H__

/**
 * @brief Start the background MQTT thread
 *
 * This thread will periodically attempt to publish temperature data
 * to an MQTT broker.
 *
 * @return 0 if the thread is started successfully, and a negative
 *         errno on error.
 */
int elce2018_mqtt_start(void);

#endif	/* ELCE2018_MQTT_H__ */
```

## src/product_id.c
```c
/*
 * Copyright (c) 2016 Linaro Limited
 *
 * SPDX-License-Identifier: Apache-2.0
 */

#include <stdio.h>
#include <zephyr.h>
#include <init.h>
#include <soc.h>
#include <gpio.h>
#include <misc/printk.h>
#include "product_id.h"

/*
 * General hardware specific configs
 *
 * DEVICE_ID_BASE  : beginning of HW UID registers
 * DEVICE_ID_LENGTH: length of HW UID registers in 32-bit words
 */
#if defined(CONFIG_SOC_SERIES_NRF52X)
#define DEVICE_ID_BASE		(&NRF_FICR->DEVICEID[0])
#define DEVICE_ID_LENGTH	2
#elif defined(CONFIG_SOC_SERIES_KINETIS_K6X)
#define DEVICE_ID_BASE		(&SIM->UIDH)
#define DEVICE_ID_LENGTH	4
#endif

static struct product_id_t product_id = {
	.name = CONFIG_BOARD,
};

const struct product_id_t *product_id_get(void)
{
	return &product_id;
}

#define HASH_MULTIPLIER		37
static u32_t hash32(char *str, int len)
{
	u32_t h = 0;
	int i;

	for (i = 0; i < len; ++i) {
		h = (h * HASH_MULTIPLIER) + str[i];
	}

	return h;
}

/* Find and set common unique device specific information */
static int product_id_init(struct device *dev)
{
	int i;
	char buffer[DEVICE_ID_LENGTH*8 + 1];

	ARG_UNUSED(dev);

	for (i = 0; i < DEVICE_ID_LENGTH; i++) {
		snprintk(buffer + i*8, sizeof(buffer) - (i*8), "%08x",
			 *(((u32_t *)DEVICE_ID_BASE) + i));
	}

	product_id.number = hash32(buffer, DEVICE_ID_LENGTH*8);

	return 0;
}

SYS_INIT(product_id_init, APPLICATION, CONFIG_KERNEL_INIT_PRIORITY_OBJECTS);
```

## src/product_id.h
```c
/*
 * Copyright (c) 2016 Linaro Limited
 * Copyright (c) 2018 Foundries.io
 *
 * SPDX-License-Identifier: Apache-2.0
 */

#ifndef ELCE2018_DEVICE_H__
#define ELCE2018_DEVICE_H__

struct product_id_t {
	const char *name;
	u32_t number;
};

/**
 * @brief Get a pointer to this device's unique ID.
 *
 * This function is safe to call from the time main() is invoked and
 * afterwards. Before, its return value is unpredictable.
 *
 * @return Pointer to product ID structure.
 */
const struct product_id_t *product_id_get(void);

#endif	/* ELCE2018_DEVICE_H__ */
```
